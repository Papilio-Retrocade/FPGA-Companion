## src/esp32/Kconfig.projbuild
```kconfig
menu "HID Example Configuration"
    config EXAMPLE_SSP_ENABLED
        bool "Secure Simple Pairing"
        depends on BT_CLASSIC_ENABLED
        default y
        help
            This enables the Secure Simple Pairing. If disable this option,
            Bluedroid will only support Legacy Pairing

    config EXAMPLE_HID_HOST_ENABLED
        bool "Enable Example HID Host"
        depends on BT_NIMBLE_ENABLED
        default y
        select BT_NIMBLE_HID_SERVICE
        help
            This enables Nimble HID Host
endmenu

menu "WiFi UDP Logging"
    config WIFI_LOG_ENABLE
        bool "Enable WiFi UDP logging"
        default n
        help
            Start WiFi in station mode and forward all log output to UDP
            broadcast packets on port 7777.  Useful when the USB port is
            occupied by USB-Host mode (HID keyboards / gamepads).
            On your PC:  ncat -u -l 7777   (Windows)
                         nc  -u -l -p 7777 (Linux/macOS)

    config WIFI_LOG_SSID
        string "WiFi SSID"
        default "YourSSID"
        depends on WIFI_LOG_ENABLE
        help
            SSID of the WiFi network to connect to for log streaming.

    config WIFI_LOG_PASSWORD
        string "WiFi Password"
        default "YourPassword"
        depends on WIFI_LOG_ENABLE
        help
            Password for the WiFi network.
endmenu
```

## src/esp32/main/Kconfig.projbuild
```kconfig
menu "USB"
    config USB_HOST_ENABLE
        bool "Enable USB HID host"
        default y
        help
            Enable the USB OTG host stack for HID keyboard/mouse/gamepad.
            Disable this to always keep the USB PHY on Serial/JTAG console
            duty (useful when debugging WiFi logging or other early-boot
            issues).

            When enabled, whether USB Host actually starts on a given boot
            is still gated by a flag persisted in NVS (see usb_host_ctrl.c):
            press the BOOT button at any time to toggle it and reboot.
endmenu

menu "WiFi UDP Logging"
    config WIFI_LOG_ENABLE
        bool "Enable WiFi UDP logging"
        default n
        help
            Start WiFi in station mode and forward all log output to UDP
            broadcast packets on port 7777.  Useful when the USB port is
            occupied by USB-Host mode (HID keyboards / gamepads).
            On your PC:  ncat -u -l 7777   (Windows)
                         nc  -u -l -p 7777 (Linux/macOS)

    config WIFI_LOG_SSID
        string "WiFi SSID"
        default "YourSSID"
        depends on WIFI_LOG_ENABLE
        help
            SSID of the WiFi network to connect to for log streaming.

    config WIFI_LOG_PASSWORD
        string "WiFi Password"
        default "YourPassword"
        depends on WIFI_LOG_ENABLE
        help
            Password for the WiFi network.
endmenu

menu "Network Recovery / ROM Loading"
    config NET_RECOVERY_ENABLE
        bool "Enable network recovery HTTP server"
        default y
        depends on WIFI_LOG_ENABLE
        help
            Start a minimal HTTP server after WiFi connects with two
            endpoints: POST /goto-loader (reboot into the
            papilio-esp-bootloader factory partition for remote
            recovery/re-flashing) and POST /rom-load (upload a ROM/cart/disk
            image to the SD card and hot-insert it).

            This app no longer flashes itself -- OTA/JTAG/firmware updates
            are handled by papilio-esp-bootloader.

            Check status:
              curl http://<device-ip>:3232/

    config NET_RECOVERY_PORT
        int "Network recovery server HTTP port"
        default 3232
        depends on NET_RECOVERY_ENABLE
        help
            TCP port the network recovery HTTP server listens on. Default
            3232 avoids conflict with common services. Must be 1024-65535.

    config NET_RECOVERY_CORS_ALLOW_ORIGIN
        string "CORS Allowed Origin (for browser-based tooling)"
        default "*"
        depends on NET_RECOVERY_ENABLE
        help
            Value sent in the Access-Control-Allow-Origin header, and used to
            satisfy Chrome's Private Network Access preflight so a HTTPS page
            (e.g. the hosted web flasher at papilioworks.com/flash) can POST
            directly to this device's endpoints from a browser.

            Set to your hosting domain (e.g. https://papilioworks.com) for
            production. "*" is fine for local development/testing.
endmenu
```
